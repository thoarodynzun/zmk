## boards/shields/lily58lp/Kconfig.defconfig
```kconfig
if SHIELD_LILY58LP_LEFT

# Name must be less than 16 characters long!
config ZMK_KEYBOARD_NAME
    default "Lily58"

endif

if SHIELD_LILY58LP_LEFT || SHIELD_LILY58LP_RIGHT

config ZMK_SPLIT
    default y

endif

if SHIELD_LILY58LP_DONGLE

config ZMK_KEYBOARD_NAME
    default "Lily58 Dongle"

config ZMK_SPLIT_ROLE_CENTRAL
    default y

config ZMK_DISPLAY
    default y

endif
```

## boards/shields/lily58lp_dongle/Kconfig.defconfig
```kconfig
if SHIELD_LILY58LP_DONGLE

config ZMK_KEYBOARD_NAME
    default "Lily58 Dongle"

config ZMK_SPLIT_ROLE_CENTRAL
    default y

config ZMK_DISPLAY
    default y

endif
```

## config/west.yml
```yaml
manifest:
  defaults:
    revision: v0.3
  remotes:
    - name: zmkfirmware
      url-base: https://github.com/zmkfirmware
    - name: a741
      url-base: https://github.com/a741725193
    - name: m165437
      url-base: https://github.com/M165437
    # Additional modules containing boards/shields/custom code can be listed here as well
    # See https://docs.zephyrproject.org/3.2.0/develop/west/manifest.html#projects
  projects:
    - name: zmk
      remote: zmkfirmware
      import: app/west.yml
    - name: zmk-sofle
      remote: a741
      revision: main
    - name: nice-view-gem
      remote: m165437
      revision: main
  self:
    path: config
```
